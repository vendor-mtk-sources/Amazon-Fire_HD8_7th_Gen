/*************************
 * Customized Battery Setting dtsi file
*************************/
&bat_comm {
	/* cust_charging.h */
	/* Linear Charging Threshold */
	v_pre2cc_thres = <3400>;   /* unit: mV */
	v_cc2topoff_thres = <4050>;
	recharging_voltage = <4110>;
	charging_full_current = <150>; /* unit: mA */

	/* Charging Current Setting */
	usb_charger_current = <50000>;	/* Unit: 0.01 mA */
	ac_charger_input_current = <100000>;	/* Unit: 0.01 mA */
	ac_charger_current = <120000>;	/* Unit: 0.01 mA */
	non_std_ac_charger_input_current = <100000>;	/* Unit: 0.01 mA */
	non_std_ac_charger_current = <120000>;	/* Unit: 0.01 mA */
	charging_host_charger_current = <50000>;	/* Unit: 0.01 mA */
	apple_0_5a_charger_current = <50000>;	/* Unit: 0.01 mA */
	apple_1_0a_charger_current = <100000>;	/* Unit: 0.01 mA */
	apple_2_1a_charger_current = <210000>;	/* Unit: 0.01 mA */

	/* Battery Temperature Protection */
	mtk_temperature_recharge_support = <1>;
	max_charge_temperature = <60>;
	max_charge_temperature_minus_x_degree = <60>;
	min_charge_temperature = <0>;
	min_charge_temperature_plus_x_degree = <6>;

	/* charger error check */
	bat_low_temp_protect_enable = <0>;
	v_charger_enable = <0>;	/* 1:on , 0:off */
	v_charger_max = <6500>;	/* unit: mV */
	v_charger_min = <4400>;

	/*  Tracking TIME */
	onehundred_percent_tracking_time = <10>;	/* Unit: second */
	npercent_tracking_time = <20>;	/* Unit: second */
	sync_to_real_tracking_time = <60>;	/* Unit: second */
	v_0percent_tracking = <3400>;	/* Unit: mV */

	/* High battery support */
	high_battery_voltage_support = <0>;

	/* JEITA related setting */
	mtk_jeita_standard_support=<1>;
	cust_soc_jeita_sync_time = <30>; /* Unit: second */
	jeita_recharge_voltage = <4110>; /* Unit: mV */
	jeita_temp_above_pos_60_cv_voltage = <4100000>; /* Unit: 0.001mV */
	jeita_temp_pos_45_to_pos_60_cv_voltage = <4100000>; /* Unit: 0.001mV */
	jeita_temp_pos_10_to_pos_45_cv_voltage = <4200000>; /* Unit: 0.001mV */
	jeita_temp_pos_0_to_pos_10_cv_voltage = <4200000>; /* Unit: 0.001mV */
	jeita_temp_neg_10_to_pos_0_cv_voltage = <4200000>; /* Unit: 0.001mV */
	jeita_temp_below_neg_10_cv_voltage = <4200000>; /* Unit: 0.001mV */

	/* For JEITA Linear Charging only */
	jeita_neg_10_to_pos_0_full_current = <120>; /* Unit: mA */
	jeita_temp_pos_45_to_pos_60_recharge_voltage = <4000>; /* Unit: mV */
	jeita_temp_pos_10_to_pos_45_recharge_voltage = <4100>; /* Unit: mV */
	jeita_temp_pos_0_to_pos_10_recharge_voltage = <4100>; /* Unit: mV */
	jeita_temp_neg_10_to_pos_0_recharge_voltage = <4100>; /* Unit: mV */
	jeita_temp_pos_45_to_pos_60_cc2topoff_threshold = <4050>; /* Unit: mV */
	jeita_temp_pos_10_to_pos_45_cc2topoff_threshold = <4050>; /* Unit: mV */
	jeita_temp_pos_0_to_pos_10_cc2topoff_threshold = <4050>; /* Unit: mV */
	jeita_temp_neg_10_to_pos_0_cc2topoff_threshold = <4050>; /* Unit: mV */
};

&bat_meter{

	/* cust_pmic.h */
	vbat_channel_number = <6>;
	isense_channel_number = <7>;
	vbattemp_channel_number = <5>;
	vcharger_channel_number = <4>;
	swchr_power_path = <1>;
	external_swchr_support = <1>;

	vbat_internal_charging = <7>;
	isense_internal_charging = <6>;

	/* cust_battery_meter.h */
	/* ADC resistor  */
	r_bat_sense = <4>;
	r_i_sense = <4>;
	r_charger_1 = <330>;
	r_charger_2 = <39>;
	temperature_t0 = <110>;
	temperature_t1 = <0>;
	temperature_t1_5 = <10>;
	temperature_t2 = <25>;
	temperature_t3 = <50>;
	temperature_t = <255>;	/* this should be fixed, never change the value */
	fg_meter_resistance = <0>;

	/* Qmax for 0mA battery 0*/
	q_max_pos_50 = <4689>;
	q_max_pos_25 = <4923>;
	q_max_pos_10 = <4635>;
	q_max_pos_0 = <4320>;
	q_max_neg_10 = <4050>;
	/* Qmax for 400mA, said high current battery 0*/
	q_max_pos_50_h_current = <4573>;
	q_max_pos_25_h_current = <4829>;
	q_max_pos_10_h_current = <4572>;
	q_max_pos_0_h_current = <3777>;
	q_max_neg_10_h_current = <2633>;

	/* Qmax for 0mA battery 1 */
	q_max_pos_50_1 = <4644>;
	q_max_pos_25_1 = <4801>;
	q_max_pos_10_1 = <4536>;
	q_max_pos_0_1 = <4536>;
	q_max_neg_10_1 = <4374>;
	/* Qmax for 400mA, said high current battery 1*/
	q_max_pos_50_h_current_1 = <4507>;
	q_max_pos_25_h_current_1 = <4706>;
	q_max_pos_10_h_current_1 = <4453>;
	q_max_pos_0_h_current_1 = <4404>;
	q_max_neg_10_h_current_1 = <4166>;

	/* Qmax_500cycle for 0mA battery 0*/
	q_max_pos_50_500cycle = <4790>;
	q_max_pos_25_500cycle = <4921>;
	q_max_pos_10_500cycle = <4706>;
	q_max_pos_0_500cycle = <4698>;
	q_max_neg_10_500cycle = <4590>;
	/* Qmax_500cycle for 600mA, high current battery 0*/
	q_max_pos_50_h_current_500cycle = <4757>;
	q_max_pos_25_h_current_500cycle = <4841>;
	q_max_pos_10_h_current_500cycle = <4674>;
	q_max_pos_0_h_current_500cycle = <4541>;
	q_max_neg_10_h_current_500cycle = <3849>;

	/* Qmax_500cycle for 0mA battery 1*/
	q_max_pos_50_500cycle_1 = <4790>;
	q_max_pos_25_500cycle_1 = <4921>;
	q_max_pos_10_500cycle_1 = <4706>;
	q_max_pos_0_500cycle_1 = <4698>;
	q_max_neg_10_500cycle_1 = <4590>;
	/* Qmax_500cycle for 600mA, high current battery 1*/
	q_max_pos_50_h_current_500cycle_1 = <4757>;
	q_max_pos_25_h_current_500cycle_1 = <4841>;
	q_max_pos_10_h_current_500cycle_1 = <4674>;
	q_max_pos_0_h_current_500cycle_1 = <4541>;
	q_max_neg_10_h_current_500cycle_1 = <3849>;

	/* Discharge percentage, 1: D5, 0: D2 */
	oam_d5 = <0>;

	change_tracking_point = <1>;
	/* SW OCV tracking setting */
	cust_tracking_point = <14>;
	cust_r_sense = <200>;
	cust_hw_cc = <0>;
	aging_tuning_value = <100>;
	cust_r_fg_offset = <0>;
	ocv_board_compesate = <0>;
	r_fg_board_base = <1000>;
	r_fg_board_slope = <1000>;
	car_tune_value = <100>;

	/* HW Fuel gague  */
	current_detect_r_fg = <10>;	/* Unit: mA */
	minerroroffset = <1000>;
	fg_vbat_average_size = <18>;
	r_fg_value = <10>;	/* Unit: mOhm */

	cust_poweron_delta_capacity_tolrance = <80>;
	cust_poweron_low_capacity_tolrance = <5>;
	cust_poweron_max_vbat_tolrance = <70>;
	cust_poweron_delta_vbat_tolrance = <60>;
	cust_poweron_delta_hw_sw_ocv_capacity_tolrance = <10>;

	/* Fixed battery temperature */
	fixed_tbat_25 = <0>;
	/* Dynamic change wake up period of battery thread when suspend */
	vbat_normal_wakeup = <3600>;	/* Unit: mV */
	vbat_low_power_wakeup = <3500>;	/* Unit: mV */
	normal_wakeup_period = <5400>;	/* Unit: second */
	low_power_wakeup_period = <300>;	/* Unit: second */
	close_poweroff_wakeup_period = <30>;	/* Unit: second */

	rbat_pull_up_r = <61900>;
	rbat_pull_down_r = <107000>;
	rbat_pull_up_volt = <1800>;

	step_of_qmax = <60>; /* Unit: mAh */

	batt_temperature_table_num = <17>;
	batt_temperature_table = <
				(-20) 499900
				(-15) 371600
				(-10) 278700
				(-5) 210800
				0 160800
				5 123800
				10 96030
				15 75100
				20 59190
				25 47000
				30 37590
				35 30270
				40 24540
				45 20020
				50 16430
				55 13570
				60 11270>;

	/* dod ocv */
	battery_profile_t0_num = <80>;
	battery_profile_t0 = <0 4167
				1 4114
				3 4079
				4 4053
				5 4026
				7 3997
				8 3975
				9 3964
				11 3958
				12 3952
				13 3948
				15 3943
				16 3938
				17 3934
				19 3928
				20 3923
				21 3917
				23 3910
				24 3904
				25 3897
				27 3889
				28 3881
				29 3872
				31 3864
				32 3855
				33 3848
				35 3841
				36 3834
				37 3828
				39 3823
				40 3819
				41 3815
				43 3811
				44 3807
				45 3804
				47 3801
				48 3798
				49 3796
				51 3794
				52 3792
				53 3791
				55 3790
				56 3788
				57 3787
				59 3786
				60 3785
				61 3783
				63 3782
				64 3780
				65 3778
				67 3776
				68 3775
				69 3772
				71 3770
				72 3768
				73 3765
				75 3762
				76 3759
				77 3755
				79 3752
				80 3748
				81 3743
				83 3739
				84 3732
				85 3728
				87 3722
				88 3716
				89 3711
				91 3706
				92 3702
				93 3699
				95 3694
				96 3688
				97 3677
				99 3653
				100 3609
				100 3609
				100 3609
				100 3609
				100 3609>;
	battery_profile_t0_num_1 = <80>;
	battery_profile_t0_1 = <0 4163
				1 4163
				2 4143
				4 4120
				5 4088
				6 4066
				7 4052
				9 4041
				10 4030
				11 4021
				12 4012
				14 4004
				15 3996
				16 3988
				17 3980
				19 3973
				20 3965
				21 3958
				22 3951
				23 3944
				25 3937
				26 3930
				27 3924
				28 3917
				30 3910
				31 3904
				32 3897
				33 3890
				35 3883
				36 3876
				37 3869
				38 3862
				40 3855
				41 3849
				42 3843
				43 3837
				44 3832
				46 3827
				47 3822
				48 3818
				49 3814
				51 3811
				52 3807
				53 3804
				54 3801
				56 3798
				57 3796
				58 3794
				59 3791
				60 3789
				62 3788
				63 3786
				65 3782
				67 3781
				69 3777
				70 3776
				72 3774
				73 3771
				74 3769
				75 3766
				77 3763
				78 3759
				79 3755
				80 3750
				81 3744
				83 3738
				84 3731
				85 3724
				86 3715
				88 3706
				89 3696
				90 3686
				91 3678
				93 3671
				94 3662
				95 3651
				96 3632
				98 3594
				99 3530
				100 3437>;

	battery_profile_t1_num = <80>;
	battery_profile_t1 = <0 4164
				1 4111
				3 4077
				4 4049
				5 4021
				6 4003
				8 3990
				9 3980
				10 3972
				11 3966
				13 3961
				14 3957
				15 3954
				16 3951
				18 3947
				19 3943
				20 3938
				21 3932
				23 3926
				24 3920
				25 3914
				26 3908
				28 3902
				29 3895
				30 3889
				31 3882
				33 3874
				34 3865
				35 3856
				36 3848
				38 3840
				39 3833
				40 3827
				41 3822
				43 3817
				44 3813
				45 3810
				46 3806
				48 3803
				49 3801
				50 3798
				51 3796
				53 3794
				54 3792
				55 3790
				56 3789
				58 3788
				59 3787
				60 3786
				61 3786
				63 3785
				65 3783
				66 3782
				68 3781
				69 3780
				70 3778
				71 3776
				73 3774
				74 3772
				75 3769
				76 3766
				78 3763
				79 3760
				80 3755
				81 3750
				83 3745
				84 3739
				85 3733
				86 3726
				88 3719
				89 3711
				90 3706
				91 3703
				93 3700
				94 3697
				95 3694
				96 3687
				98 3671
				99 3630
				100 3567>;
	battery_profile_t1_num_1 = <80>;
	battery_profile_t1_1 = <0 4179
				1 4132
				2 4106
				4 4090
				5 4077
				6 4066
				7 4056
				8 4045
				10 4036
				11 4027
				12 4019
				13 4010
				14 4002
				15 3993
				17 3985
				18 3978
				19 3971
				20 3964
				21 3957
				23 3951
				24 3943
				25 3937
				26 3931
				27 3924
				29 3918
				30 3912
				31 3905
				32 3898
				33 3892
				35 3885
				36 3878
				37 3871
				38 3864
				39 3857
				40 3850
				42 3843
				43 3837
				44 3831
				45 3825
				46 3821
				48 3816
				49 3812
				50 3808
				51 3804
				52 3801
				54 3798
				55 3795
				56 3793
				57 3790
				58 3788
				60 3786
				62 3783
				64 3780
				65 3778
				68 3776
				70 3773
				71 3771
				74 3766
				75 3763
				76 3760
				77 3756
				79 3752
				80 3747
				81 3742
				82 3736
				83 3730
				85 3723
				86 3715
				87 3708
				88 3698
				89 3687
				90 3677
				92 3671
				93 3664
				94 3657
				95 3648
				96 3628
				98 3583
				99 3519
				100 3431>;

	battery_profile_t1_5_num = <80>;
	battery_profile_t1_5 = <0 4178
				1 4119
				2 4104
				3 4092
				5 4086
				6 4082
				7 4076
				8 4066
				9 4048
				10 4025
				12 4007
				13 3994
				14 3977
				15 3971
				16 3966
				17 3963
				19 3960
				20 3958
				21 3953
				22 3948
				23 3942
				24 3936
				26 3929
				27 3923
				28 3918
				29 3912
				30 3906
				31 3900
				33 3895
				34 3889
				35 3883
				36 3876
				37 3869
				38 3860
				40 3850
				41 3840
				42 3833
				43 3826
				44 3821
				45 3817
				47 3813
				48 3809
				49 3806
				50 3803
				51 3800
				52 3798
				54 3795
				55 3793
				57 3789
				58 3787
				59 3785
				61 3784
				63 3783
				65 3782
				68 3780
				70 3778
				72 3775
				73 3773
				75 3770
				76 3767
				77 3763
				78 3760
				79 3756
				80 3752
				82 3746
				83 3740
				84 3733
				85 3727
				86 3720
				87 3711
				89 3704
				90 3701
				91 3699
				93 3696
				94 3693
				96 3684
				97 3646
				98 3587
				99 3506
				100 3379>;
	battery_profile_t1_5_num_1 = <80>;
	battery_profile_t1_5_1 = <0 4179
				1 4128
				2 4113
				4 4100
				5 4089
				6 4078
				7 4068
				8 4058
				10 4049
				11 4040
				12 4031
				13 4022
				14 4014
				15 4006
				17 3998
				18 3990
				19 3983
				20 3975
				21 3968
				23 3961
				24 3954
				25 3948
				26 3941
				27 3935
				29 3929
				30 3922
				31 3916
				32 3910
				33 3904
				35 3897
				36 3891
				37 3884
				38 3877
				39 3869
				40 3862
				42 3855
				43 3848
				44 3841
				45 3835
				46 3829
				48 3824
				49 3819
				50 3814
				51 3811
				52 3807
				54 3804
				55 3800
				56 3798
				57 3795
				58 3793
				60 3790
				61 3788
				63 3784
				65 3781
				67 3780
				69 3777
				71 3774
				74 3770
				75 3767
				76 3763
				77 3759
				79 3754
				80 3750
				81 3746
				82 3742
				83 3736
				85 3730
				86 3723
				87 3717
				88 3710
				89 3701
				90 3690
				92 3682
				93 3677
				94 3671
				95 3664
				96 3656
				98 3635
				99 3591
				100 3532>;

	battery_profile_t2_num = <80>;
	battery_profile_t2 = <0 4177
				1 4157
				2 4139
				3 4127
				4 4115
				5 4104
				7 4094
				8 4084
				9 4076
				10 4071
				11 4067
				12 4060
				13 4047
				14 4027
				15 4009
				16 3995
				18 3985
				19 3978
				20 3971
				21 3967
				22 3965
				23 3963
				24 3958
				25 3951
				26 3944
				27 3938
				29 3932
				30 3925
				31 3919
				32 3913
				33 3908
				34 3902
				35 3896
				36 3891
				37 3885
				38 3880
				39 3873
				41 3866
				42 3857
				43 3845
				44 3835
				45 3827
				46 3821
				47 3816
				48 3812
				49 3808
				50 3805
				52 3801
				53 3798
				55 3793
				57 3788
				59 3783
				61 3779
				64 3776
				66 3774
				68 3772
				70 3770
				72 3767
				73 3764
				75 3761
				76 3759
				77 3755
				78 3751
				79 3746
				81 3739
				82 3735
				83 3729
				84 3722
				86 3716
				87 3710
				88 3702
				89 3693
				90 3690
				92 3687
				94 3684
				95 3680
				97 3657
				98 3609
				99 3544
				100 3450>;
	battery_profile_t2_num_1 = <80>;
	battery_profile_t2_1 = <0 4179
				1 4157
				2 4140
				3 4125
				4 4111
				6 4100
				7 4089
				8 4078
				9 4069
				10 4059
				11 4049
				12 4040
				13 4031
				15 4023
				16 4014
				17 4006
				18 3998
				19 3990
				20 3982
				21 3975
				22 3968
				24 3961
				25 3954
				26 3947
				27 3940
				28 3934
				29 3928
				30 3922
				31 3916
				33 3910
				34 3904
				35 3898
				36 3892
				37 3885
				38 3879
				39 3872
				40 3865
				42 3857
				43 3849
				44 3842
				45 3834
				46 3828
				47 3823
				48 3817
				49 3813
				51 3808
				52 3804
				54 3797
				55 3794
				57 3789
				60 3784
				63 3778
				65 3774
				67 3772
				69 3770
				71 3767
				73 3761
				74 3757
				75 3752
				76 3747
				78 3743
				79 3738
				81 3731
				82 3726
				83 3720
				84 3714
				85 3706
				87 3701
				88 3692
				89 3684
				90 3674
				91 3671
				92 3665
				93 3660
				94 3652
				96 3637
				97 3601
				98 3549
				99 3482
				100 3392>;

	battery_profile_t3_num = <80>;
	battery_profile_t3 = <0 4179
				1 4140
				2 4119
				3 4104
				5 4092
				6 4086
				7 4082
				8 4077
				9  4067
				10 4048
				12 4025
				13 4007
				14 3994
				15 3978
				16 3972
				17 3967
				18 3964
				20 3960
				21 3958
				22 3954
				23 3948
				24 3943
				25 3936
				26 3930
				28 3924
				29 3918
				30 3912
				31 3907
				32 3900
				33 3895
				35 3890
				36 3883
				37 3877
				38 3870
				39 3860
				40 3850
				41 3841
				43 3833
				44 3827
				45 3821
				46 3817
				47 3814
				48 3810
				50 3806
				51 3804
				52 3801
				53 3798
				54 3796
				55 3794
				56 3791
				58 3790
				59 3787
				61 3785
				63 3784
				66 3782
				68 3780
				70 3778
				73 3776
				74 3774
				75 3771
				76 3767
				77 3764
				78 3760
				79 3757
				81 3752
				82 3747
				83 3740
				84 3734
				85 3728
				86 3721
				88 3712
				89 3704
				90 3701
				93 3697
				94 3693
				96 3684
				97 3646
				98 3587
				99 3506
				100 3380>;
	battery_profile_t3_num_1 = <80>;
	battery_profile_t3_1 = <0 4183
				1 4151
				2 4128
				3 4113
				5 4100
				6 4089
				7 4078
				8 4068
				9 4058
				10 4049
				12 4040
				13 4031
				14 4022
				15 4014
				16 4006
				17 3998
				19 3990
				20 3983
				21 3975
				22 3968
				23 3961
				24 3954
				25 3948
				27 3941
				28 3935
				29 3929
				30 3922
				31 3916
				33 3910
				34 3904
				35 3897
				36 3891
				37 3884
				38 3877
				40 3869
				41 3862
				42 3855
				43 3848
				44 3841
				45 3835
				47 3829
				48 3824
				49 3819
				50 3814
				51 3811
				52 3807
				55 3800
				57 3795
				59 3790
				62 3786
				64 3783
				65 3781
				66 3780
				69 3777
				70 3776
				72 3772
				73 3770
				74 3767
				76 3763
				77 3759
				78 3754
				79 3750
				80 3746
				81 3742
				83 3736
				84 3730
				85 3723
				86 3717
				87 3710
				88 3701
				90 3690
				91 3682
				92 3677
				93 3671
				94 3664
				95 3656
				97 3635
				98 3591
				99 3532
				100 3454>;

	/* r ocv */
	r_profile_t0_num = <80>;
	r_profile_t0 = <323 4167
				323 4114
				309 4079
				319 4053
				370 4026
				413 3997
				436 3975
				445 3964
				453 3958
				459 3952
				465 3948
				472 3943
				480 3938
				486 3934
				490 3928
				491 3923
				492 3917
				495 3910
				494 3904
				497 3897
				493 3889
				492 3881
				477 3872
				464 3864
				451 3855
				463 3848
				450 3841
				439 3834
				429 3828
				421 3823
				412 3819
				410 3815
				418 3811
				424 3807
				429 3804
				435 3801
				437 3798
				439 3796
				441 3794
				447 3792
				454 3791
				463 3790
				470 3788
				477 3787
				485 3786
				492 3785
				501 3783
				510 3782
				518 3780
				522 3778
				526 3776
				531 3775
				544 3772
				556 3770
				566 3768
				575 3765
				587 3762
				598 3759
				608 3755
				614 3752
				623 3748
				634 3743
				651 3739
				587 3732
				628 3728
				657 3722
				681 3716
				706 3711
				735 3706
				766 3702
				774 3699
				820 3694
				877 3688
				955 3677
				1044 3653
				1150 3609
				1150 3609
				1150 3609
				1150 3609
				1150 3609>;
	r_profile_t0_num_1 = <80>;
	r_profile_t0_1 = <247 4163
				247 4163
				259 4143
				285 4120
				290 4088
				286 4066
				287 4052
				291 4041
				295 4030
				299 4021
				302 4012
				304 4004
				306 3996
				308 3988
				309 3980
				312 3973
				312 3965
				314 3958
				311 3951
				307 3944
				304 3937
				299 3930
				295 3924
				292 3917
				288 3910
				285 3904
				282 3897
				280 3890
				281 3883
				283 3876
				284 3869
				285 3862
				285 3855
				284 3849
				284 3843
				285 3837
				287 3832
				289 3827
				291 3822
				293 3818
				295 3814
				296 3811
				298 3807
				300 3804
				301 3801
				300 3798
				299 3796
				298 3794
				299 3791
				301 3789
				301 3788
				302 3786
				303 3782
				303 3781
				300 3777
				299 3776
				300 3774
				276 3771
				283 3769
				287 3766
				289 3763
				290 3759
				291 3755
				291 3750
				290 3744
				290 3738
				291 3731
				294 3724
				298 3715
				303 3706
				309 3696
				319 3686
				334 3678
				353 3671
				376 3662
				409 3651
				454 3632
				515 3594
				607 3530
				793 3437>;

	r_profile_t1_num = <80>;
	r_profile_t1 = <200 4164
				200 4111
				202 4077
				202 4049
				189 4021
				181 4003
				179 3990
				177 3980
				178 3972
				179 3966
				183 3961
				186 3957
				190 3954
				193 3951
				196 3947
				198 3943
				200 3938
				196 3932
				204 3926
				205 3920
				205 3914
				206 3908
				206 3902
				206 3895
				205 3889
				203 3882
				200 3874
				195 3865
				190 3856
				184 3848
				180 3840
				177 3833
				175 3827
				173 3822
				172 3817
				172 3813
				172 3810
				173 3806
				173 3803
				174 3801
				175 3798
				176 3796
				177 3794
				178 3792
				180 3790
				183 3789
				186 3788
				189 3787
				192 3786
				196 3786
				200 3785
				209 3783
				215 3782
				220 3781
				226 3780
				227 3778
				238 3776
				243 3774
				211 3772
				258 3769
				266 3766
				274 3763
				283 3760
				292 3755
				302 3750
				313 3745
				324 3739
				337 3733
				349 3726
				362 3719
				376 3711
				393 3706
				419 3703
				452 3700
				495 3697
				549 3694
				617 3687
				706 3671
				820 3630
				974 3567>;
	r_profile_t1_num_1 = <80>;
	r_profile_t1_1 = <199 4179
				199 4132
				189 4106
				187 4090
				187 4077
				188 4066
				189 4056
				189 4045
				191 4036
				192 4027
				193 4019
				194 4010
				195 4002
				195 3993
				196 3985
				197 3978
				196 3971
				199 3964
				200 3957
				201 3951
				201 3943
				202 3937
				202 3931
				202 3924
				203 3918
				203 3912
				202 3905
				201 3898
				201 3892
				200 3885
				199 3878
				197 3871
				196 3864
				194 3857
				191 3850
				189 3843
				188 3837
				187 3831
				186 3825
				185 3821
				186 3816
				185 3812
				186 3808
				185 3804
				186 3801
				187 3798
				188 3795
				188 3793
				188 3790
				188 3788
				188 3786
				189 3783
				190 3780
				188 3778
				192 3776
				193 3773
				193 3771
				194 3766
				195 3763
				195 3760
				196 3756
				196 3752
				196 3747
				198 3742
				199 3736
				201 3730
				203 3723
				205 3715
				209 3708
				210 3698
				210 3687
				212 3677
				222 3671
				234 3664
				250 3657
				274 3648
				313 3628
				358 3583
				421 3519
				534 3431>;

	r_profile_t1_5_num = <80>;
	r_profile_t1_5 = <248 4178
				248 4119
				251 4104
				253 4092
				258 4086
				265 4082
				271 4076
				272 4066
				267 4048
				261 4025
				259 4007
				259 3994
				248 3977
				250 3971
				254 3966
				258 3963
				263 3960
				266 3958
				267 3953
				265 3948
				264 3942
				264 3936
				265 3929
				266 3923
				268 3918
				269 3912
				271 3906
				271 3900
				272 3895
				273 3889
				273 3883
				271 3876
				268 3869
				263 3860
				255 3850
				248 3840
				245 3833
				242 3826
				241 3821
				241 3817
				241 3813
				241 3809
				241 3806
				242 3803
				242 3800
				243 3798
				244 3795
				245 3793
				246 3789
				247 3787
				248 3785
				249 3784
				252 3783
				254 3782
				256 3780
				259 3778
				261 3775
				261 3773
				261 3770
				261 3767
				261 3763
				262 3760
				264 3756
				266 3752
				266 3746
				266 3740
				268 3733
				272 3727
				275 3720
				275 3711
				282 3704
				293 3701
				300 3699
				321 3696
				335 3693
				347 3684
				325 3646
				300 3587
				293 3506
				268 3379>;
	r_profile_t1_5_num_1 = <80>;
	r_profile_t1_5_1 = <148 4179
				148 4128
				146 4113
				144 4100
				145 4089
				145 4078
				146 4068
				146 4058
				147 4049
				147 4040
				148 4031
				149 4022
				150 4014
				150 4006
				164 3998
				165 3990
				165 3983
				165 3975
				165 3968
				166 3961
				166 3954
				167 3948
				167 3941
				167 3935
				167 3929
				167 3922
				167 3916
				167 3910
				167 3904
				166 3897
				166 3891
				165 3884
				163 3877
				161 3869
				159 3862
				156 3855
				153 3848
				151 3841
				149 3835
				147 3829
				145 3824
				144 3819
				143 3814
				143 3811
				142 3807
				142 3804
				142 3800
				143 3798
				142 3795
				142 3793
				143 3790
				143 3788
				143 3784
				143 3781
				142 3780
				144 3777
				145 3774
				147 3770
				148 3767
				149 3763
				148 3759
				148 3754
				149 3750
				151 3746
				154 3742
				156 3736
				158 3730
				160 3723
				163 3717
				168 3710
				167 3701
				162 3690
				163 3682
				171 3677
				183 3671
				205 3664
				259 3656
				328 3635
				393 3591
				500 3532>;

	r_profile_t2_num = <80>;
	r_profile_t2 = <99 4177
				99 4157
				88 4139
				90 4127
				90 4115
				92 4104
				92 4094
				88 4084
				90 4076
				92 4071
				96 4067
				106 4060
				108 4047
				106 4027
				101 4009
				93 3995
				87 3985
				84 3978
				86 3971
				86 3967
				88 3965
				90 3963
				92 3958
				94 3951
				96 3944
				98 3938
				101 3932
				101 3925
				101 3919
				103 3913
				106 3908
				106 3902
				108 3896
				110 3891
				112 3885
				112 3880
				112 3873
				111 3866
				104 3857
				97 3845
				88 3835
				81 3827
				80 3821
				77 3816
				73 3812
				77 3808
				73 3805
				76 3801
				73 3798
				76 3793
				76 3788
				76 3783
				74 3779
				74 3776
				74 3774
				76 3772
				77 3770
				78 3767
				79 3764
				78 3761
				80 3759
				81 3755
				81 3751
				76 3746
				82 3739
				84 3735
				88 3729
				87 3722
				88 3716
				91 3710
				94 3702
				81 3693
				82 3690
				84 3687
				99 3684
				133 3680
				181 3657
				223 3609
				287 3544
				434 3450>;
	r_profile_t2_num_1 = <80>;
	r_profile_t2_1 = <126 4179
				126 4157
				125 4140
				121 4125
				119 4111
				120 4100
				118 4089
				118 4078
				120 4069
				119 4059
				119 4049
				120 4040
				118 4031
				121 4023
				120 4014
				120 4006
				121 3998
				121 3990
				120 3982
				120 3975
				122 3968
				123 3961
				123 3954
				123 3947
				123 3940
				124 3934
				125 3928
				127 3922
				128 3916
				128 3910
				128 3904
				129 3898
				128 3892
				129 3885
				128 3879
				128 3872
				126 3865
				123 3857
				120 3849
				119 3842
				114 3834
				114 3828
				113 3823
				110 3817
				111 3813
				108 3808
				109 3804
				109 3797
				108 3794
				110 3789
				110 3784
				111 3778
				110 3774
				111 3772
				111 3770
				112 3767
				112 3761
				112 3757
				111 3752
				111 3747
				111 3743
				110 3738
				113 3731
				114 3726
				114 3720
				116 3714
				114 3706
				118 3701
				120 3692
				120 3684
				113 3674
				118 3671
				118 3665
				127 3660
				137 3652
				170 3637
				197 3601
				226 3549
				272 3482
				382 3392>;

	r_profile_t3_num = <80>;
	r_profile_t3 = <133 4179
				133 4140
				127 4119
				122 4104
				118 4092
				122 4086
				129 4082
				138 4077
				148 4067
				150 4048
				139 4025
				129 4007
				125 3994
				110 3978
				111 3972
				114 3967
				118 3964
				120 3960
				124 3958
				123 3954
				123 3948
				126 3943
				126 3936
				126 3930
				128 3924
				129 3918
				129 3912
				131 3907
				131 3900
				131 3895
				133 3890
				131 3883
				131 3877
				128 3870
				122 3860
				115 3850
				148 3841
				142 3833
				139 3827
				138 3821
				187 3817
				187 3814
				186 3810
				267 3806
				267 3804
				268 3801
				267 3798
				268 3796
				270 3794
				269 3791
				271 3790
				271 3787
				272 3785
				274 3784
				275 3782
				278 3780
				281 3778
				285 3776
				287 3774
				286 3771
				287 3767
				259 3764
				259 3760
				263 3757
				185 3752
				187 3747
				189 3740
				192 3734
				197 3728
				202 3721
				204 3712
				206 3704
				213 3701
				192 3697
				212 3693
				238 3684
				247 3646
				278 3587
				329 3506
				413 3380>;
	r_profile_t3_num_1 = <80>;
	r_profile_t3_1 = <157 4183
				157 4151
				148 4128
				146 4113
				144 4100
				145 4089
				145 4078
				146 4068
				146 4058
				147 4049
				147 4040
				148 4031
				149 4022
				150 4014
				150 4006
				164 3998
				165 3990
				165 3983
				165 3975
				165 3968
				166 3961
				166 3954
				167 3948
				167 3941
				167 3935
				167 3929
				167 3922
				167 3916
				167 3910
				167 3904
				166 3897
				166 3891
				165 3884
				163 3877
				161 3869
				159 3862
				156 3855
				153 3848
				151 3841
				149 3835
				147 3829
				145 3824
				144 3819
				143 3814
				143 3811
				142 3807
				142 3800
				142 3795
				143 3790
				142 3786
				142 3783
				143 3781
				142 3780
				144 3777
				145 3776
				146 3772
				147 3770
				148 3767
				149 3763
				148 3759
				148 3754
				149 3750
				151 3746
				154 3742
				156 3736
				158 3730
				160 3723
				163 3717
				168 3710
				167 3701
				162 3690
				163 3682
				171 3677
				183 3671
				205 3664
				259 3656
				328 3635
				393 3591
				500 3532
				813 3454>;

	/* Battery 500 cycle ZCV */
	battery_profile_t1_500cycle = <0 4158
				1 4144
				2 4133
				3 4123
				5 4113
				6 4104
				7 4099
				8 4097
				9 4094
				10 4086
				11 4067
				13 4038
				14 4014
				15 3998
				16 3987
				17 3978
				18 3971
				20 3965
				21 3960
				22 3955
				23 3952
				24 3949
				25 3947
				26 3943
				28 3936
				29 3929
				30 3922
				31 3915
				32 3907
				33 3899
				34 3891
				36 3883
				37 3875
				38 3867
				39 3860
				40 3853
				41 3847
				43 3841
				44 3836
				45 3830
				46 3826
				47 3822
				48 3818
				49 3814
				51 3811
				52 3808
				53 3805
				54 3802
				55 3799
				56 3797
				57 3794
				60 3790
				62 3788
				64 3786
				67 3784
				69 3782
				70 3781
				72 3778
				75 3774
				77 3769
				78 3766
				79 3763
				80 3759
				82 3754
				83 3748
				84 3742
				85 3736
				86 3729
				87 3721
				89 3713
				90 3708
				91 3705
				92 3702
				93 3700
				94 3696
				95 3688
				97 3662
				98 3611
				99 3540
				100 3436>;

	battery_profile_t1_5_500cycle = <0 4165
				1 4152
				2 4141
				3 4131
				5 4121
				6 4112
				7 4105
				8 4102
				9 4100
				10 4094
				11 4078
				13 4053
				14 4029
				15 4012
				16 4000
				17 3991
				18 3984
				19 3978
				21 3973
				22 3969
				23 3967
				24 3965
				25 3961
				26 3956
				27 3950
				29 3943
				30 3937
				31 3931
				32 3924
				33 3918
				34 3911
				36 3904
				37 3896
				38 3888
				39 3879
				40 3870
				41 3861
				42 3854
				44 3847
				45 3841
				46 3836
				47 3831
				48 3827
				49 3823
				50 3820
				52 3816
				53 3814
				54 3811
				55 3808
				56 3805
				57 3803
				60 3799
				62 3795
				63 3793
				65 3792
				68 3790
				70 3788
				72 3786
				74 3782
				76 3779
				77 3776
				78 3772
				79 3768
				80 3764
				81 3760
				82 3755
				84 3748
				85 3741
				86 3736
				87 3729
				88 3719
				89 3712
				90 3709
				92 3708
				94 3704
				95 3702
				96 3691
				97 3647
				98 3585
				100 3499>;

	battery_profile_t2_500cycle = <0 4174
				1 4167
				2 4151
				3 4138
				4 4127
				5 4116
				7 4106
				8 4096
				9 4086
				10 4077
				11 4071
				12 4069
				13 4065
				14 4053
				15 4034
				16 4014
				18 3998
				19 3987
				20 3978
				21 3971
				22 3966
				23 3965
				24 3961
				25 3956
				26 3949
				27 3943
				29 3935
				30 3928
				31 3920
				32 3914
				33 3907
				34 3901
				35 3897
				36 3892
				38 3881
				40 3876
				41 3870
				42 3864
				43 3855
				44 3845
				45 3835
				46 3826
				47 3819
				49 3809
				50 3805
				52 3801
				53 3797
				55 3792
				56 3789
				58 3783
				59 3781
				61 3776
				63 3773
				65 3770
				66 3769
				67 3767
				69 3766
				71 3763
				72 3760
				74 3755
				76 3748
				77 3745
				79 3736
				80 3732
				82 3726
				83 3720
				84 3713
				86 3707
				87 3701
				88 3693
				89 3683
				90 3679
				92 3677
				94 3674
				95 3669
				97 3645
				98 3596
				99 3531
				100 3438
				100 3279>;

	battery_profile_t3_500cycle = <0 4174
				1 4161
				2 4150
				3 4138
				4 4128
				6 4118
				7 4107
				8 4097
				9 4088
				10 4078
				11 4072
				12 4067
				14 4056
				15 4041
				16 4027
				17 4017
				18 4011
				19 4006
				20 3999
				21 3992
				23 3984
				24 3977
				25 3969
				26 3962
				27 3955
				28 3948
				29 3941
				30 3934
				32 3928
				33 3922
				34 3916
				35 3910
				36 3904
				37 3898
				38 3893
				39 3887
				41 3881
				42 3873
				43 3863
				44 3851
				45 3842
				46 3836
				47 3831
				48 3826
				50 3822
				51 3818
				52 3815
				54 3808
				55 3805
				57 3799
				60 3794
				61 3792
				63 3788
				65 3784
				68 3780
				70 3777
				71 3774
				72 3766
				73 3760
				74 3756
				75 3752
				77 3749
				78 3744
				79 3740
				80 3737
				82 3729
				83 3723
				84 3716
				86 3709
				87 3703
				88 3695
				89 3688
				91 3686
				93 3683
				95 3679
				96 3667
				97 3627
				98 3571
				99 3496
				100 3384>;

	r_profile_t1_500cycle = <237 4158
				237 4144
				241 4133
				243 4123
				245 4113
				245 4104
				245 4099
				253 4097
				262 4094
				267 4086
				268 4067
				264 4038
				262 4014
				262 3998
				264 3987
				264 3978
				266 3971
				266 3965
				267 3960
				269 3955
				270 3952
				273 3949
				275 3947
				276 3943
				275 3936
				273 3929
				273 3922
				272 3915
				270 3907
				267 3899
				263 3891
				261 3883
				258 3875
				255 3867
				254 3860
				251 3853
				249 3847
				248 3841
				248 3836
				246 3830
				246 3826
				247 3822
				248 3818
				249 3814
				249 3811
				250 3808
				251 3805
				253 3802
				246 3799
				254 3797
				254 3794
				257 3790
				258 3788
				258 3786
				260 3784
				261 3782
				263 3781
				265 3778
				267 3774
				267 3769
				268 3766
				269 3763
				270 3759
				271 3754
				272 3748
				273 3742
				275 3736
				278 3729
				280 3721
				282 3713
				287 3708
				295 3705
				306 3702
				322 3700
				348 3696
				382 3688
				422 3662
				480 3611
				591 3540
				802 3436>;

	r_profile_t1_5_500cycle = <154 4165
				154 4152
				155 4141
				156 4131
				157 4121
				159 4112
				158 4105
				160 4102
				166 4100
				170 4094
				169 4078
				169 4053
				171 4029
				170 4012
				171 4000
				171 3991
				174 3984
				175 3978
				177 3973
				178 3969
				181 3967
				183 3965
				185 3961
				185 3956
				187 3950
				188 3943
				189 3937
				191 3931
				190 3924
				192 3918
				190 3911
				189 3904
				187 3896
				184 3888
				178 3879
				174 3870
				168 3861
				164 3854
				162 3847
				160 3841
				160 3836
				159 3831
				158 3827
				159 3823
				159 3820
				159 3816
				160 3814
				161 3811
				159 3808
				161 3805
				161 3803
				164 3799
				165 3795
				164 3793
				165 3792
				166 3790
				166 3788
				166 3786
				165 3782
				165 3779
				164 3776
				163 3772
				163 3768
				163 3764
				164 3760
				164 3755
				163 3748
				163 3741
				165 3736
				167 3729
				164 3719
				164 3712
				165 3709
				168 3708
				177 3704
				186 3702
				193 3691
				184 3647
				193 3585
				210 3499>;

	r_profile_t2_500cycle = <125 4174
				125 4167
				120 4151
				118 4138
				118 4127
				118 4116
				118 4106
				118 4096
				117 4086
				112 4077
				108 4071
				114 4069
				124 4065
				136 4053
				138 4034
				130 4014
				124 3998
				120 3987
				117 3978
				114 3971
				111 3966
				115 3965
				120 3961
				122 3956
				124 3949
				126 3943
				125 3935
				123 3928
				118 3920
				118 3914
				117 3907
				118 3901
				124 3897
				128 3892
				135 3881
				135 3876
				138 3870
				141 3864
				138 3855
				132 3845
				124 3835
				118 3826
				114 3819
				110 3809
				109 3805
				106 3801
				108 3797
				108 3792
				107 3789
				109 3783
				106 3781
				107 3776
				107 3773
				108 3770
				108 3769
				108 3767
				109 3766
				110 3763
				109 3760
				107 3755
				106 3748
				107 3745
				106 3736
				106 3732
				111 3726
				113 3720
				111 3713
				111 3707
				114 3701
				116 3693
				105 3683
				101 3679
				106 3677
				119 3674
				145 3669
				188 3645
				220 3596
				274 3531
				411 3438
				354 3279>;

	r_profile_t3_500cycle = <94 4174
				94 4161
				95 4150
				94 4138
				94 4128
				95 4118
				95 4107
				95 4097
				96 4088
				95 4078
				97 4072
				98 4067
				97 4056
				97 4041
				97 4027
				96 4017
				98 4011
				98 4006
				98 3999
				98 3992
				99 3984
				99 3977
				100 3969
				100 3962
				101 3955
				101 3948
				102 3941
				103 3934
				103 3928
				104 3922
				104 3916
				106 3910
				106 3904
				108 3898
				111 3893
				112 3887
				113 3881
				113 3873
				109 3863
				102 3851
				99 3842
				97 3836
				96 3826
				96 3822
				96 3815
				95 3808
				97 3805
				97 3799
				98 3794
				98 3792
				99 3788
				101 3784
				102 3780
				102 3777
				101 3774
				96 3766
				96 3760
				96 3756
				96 3752
				96 3749
				96 3744
				96 3740
				96 3737
				97 3729
				97 3723
				96 3716
				95 3709
				97 3703
				97 3695
				95 3688
				97 3686
				101 3683
				105 3679
				104 3667
				101 3627
				103 3571
				110 3496
				122 3384
				122 3384
				254 3161>;

	battery_profile_t1_500cycle_1 = <0 4158
				1 4144
				2 4133
				3 4123
				5 4113
				6 4104
				7 4099
				8 4097
				9 4094
				10 4086
				11 4067
				13 4038
				14 4014
				15 3998
				16 3987
				17 3978
				18 3971
				20 3965
				21 3960
				22 3955
				23 3952
				24 3949
				25 3947
				26 3943
				28 3936
				29 3929
				30 3922
				31 3915
				32 3907
				33 3899
				34 3891
				36 3883
				37 3875
				38 3867
				39 3860
				40 3853
				41 3847
				43 3841
				44 3836
				45 3830
				46 3826
				47 3822
				48 3818
				49 3814
				51 3811
				52 3808
				53 3805
				54 3802
				55 3799
				56 3797
				57 3794
				60 3790
				62 3788
				64 3786
				67 3784
				69 3782
				70 3781
				72 3778
				75 3774
				77 3769
				78 3766
				79 3763
				80 3759
				82 3754
				83 3748
				84 3742
				85 3736
				86 3729
				87 3721
				89 3713
				90 3708
				91 3705
				92 3702
				93 3700
				94 3696
				95 3688
				97 3662
				98 3611
				99 3540
				100 3436>;

	battery_profile_t1_5_500cycle_1 = <0 4165
				1 4152
				2 4141
				3 4131
				5 4121
				6 4112
				7 4105
				8 4102
				9 4100
				10 4094
				11 4078
				13 4053
				14 4029
				15 4012
				16 4000
				17 3991
				18 3984
				19 3978
				21 3973
				22 3969
				23 3967
				24 3965
				25 3961
				26 3956
				27 3950
				29 3943
				30 3937
				31 3931
				32 3924
				33 3918
				34 3911
				36 3904
				37 3896
				38 3888
				39 3879
				40 3870
				41 3861
				42 3854
				44 3847
				45 3841
				46 3836
				47 3831
				48 3827
				49 3823
				50 3820
				52 3816
				53 3814
				54 3811
				55 3808
				56 3805
				57 3803
				60 3799
				62 3795
				63 3793
				65 3792
				68 3790
				70 3788
				72 3786
				74 3782
				76 3779
				77 3776
				78 3772
				79 3768
				80 3764
				81 3760
				82 3755
				84 3748
				85 3741
				86 3736
				87 3729
				88 3719
				89 3712
				90 3709
				92 3708
				94 3704
				95 3702
				96 3691
				97 3647
				98 3585
				100 3499>;

	battery_profile_t2_500cycle_1 = <0 4174
				1 4167
				2 4151
				3 4138
				4 4127
				5 4116
				7 4106
				8 4096
				9 4086
				10 4077
				11 4071
				12 4069
				13 4065
				14 4053
				15 4034
				16 4014
				18 3998
				19 3987
				20 3978
				21 3971
				22 3966
				23 3965
				24 3961
				25 3956
				26 3949
				27 3943
				29 3935
				30 3928
				31 3920
				32 3914
				33 3907
				34 3901
				35 3897
				36 3892
				38 3881
				40 3876
				41 3870
				42 3864
				43 3855
				44 3845
				45 3835
				46 3826
				47 3819
				49 3809
				50 3805
				52 3801
				53 3797
				55 3792
				56 3789
				58 3783
				59 3781
				61 3776
				63 3773
				65 3770
				66 3769
				67 3767
				69 3766
				71 3763
				72 3760
				74 3755
				76 3748
				77 3745
				79 3736
				80 3732
				82 3726
				83 3720
				84 3713
				86 3707
				87 3701
				88 3693
				89 3683
				90 3679
				92 3677
				94 3674
				95 3669
				97 3645
				98 3596
				99 3531
				100 3438
				100 3279>;

	battery_profile_t3_500cycle_1 = <0 4174
				1 4161
				2 4150
				3 4138
				4 4128
				6 4118
				7 4107
				8 4097
				9 4088
				10 4078
				11 4072
				12 4067
				14 4056
				15 4041
				16 4027
				17 4017
				18 4011
				19 4006
				20 3999
				21 3992
				23 3984
				24 3977
				25 3969
				26 3962
				27 3955
				28 3948
				29 3941
				30 3934
				32 3928
				33 3922
				34 3916
				35 3910
				36 3904
				37 3898
				38 3893
				39 3887
				41 3881
				42 3873
				43 3863
				44 3851
				45 3842
				46 3836
				47 3831
				48 3826
				50 3822
				51 3818
				52 3815
				54 3808
				55 3805
				57 3799
				60 3794
				61 3792
				63 3788
				65 3784
				68 3780
				70 3777
				71 3774
				72 3766
				73 3760
				74 3756
				75 3752
				77 3749
				78 3744
				79 3740
				80 3737
				82 3729
				83 3723
				84 3716
				86 3709
				87 3703
				88 3695
				89 3688
				91 3686
				93 3683
				95 3679
				96 3667
				97 3627
				98 3571
				99 3496
				100 3384>;

	r_profile_t1_500cycle_1 = <237 4158
				237 4144
				241 4133
				243 4123
				245 4113
				245 4104
				245 4099
				253 4097
				262 4094
				267 4086
				268 4067
				264 4038
				262 4014
				262 3998
				264 3987
				264 3978
				266 3971
				266 3965
				267 3960
				269 3955
				270 3952
				273 3949
				275 3947
				276 3943
				275 3936
				273 3929
				273 3922
				272 3915
				270 3907
				267 3899
				263 3891
				261 3883
				258 3875
				255 3867
				254 3860
				251 3853
				249 3847
				248 3841
				248 3836
				246 3830
				246 3826
				247 3822
				248 3818
				249 3814
				249 3811
				250 3808
				251 3805
				253 3802
				246 3799
				254 3797
				254 3794
				257 3790
				258 3788
				258 3786
				260 3784
				261 3782
				263 3781
				265 3778
				267 3774
				267 3769
				268 3766
				269 3763
				270 3759
				271 3754
				272 3748
				273 3742
				275 3736
				278 3729
				280 3721
				282 3713
				287 3708
				295 3705
				306 3702
				322 3700
				348 3696
				382 3688
				422 3662
				480 3611
				591 3540
				802 3436>;

	r_profile_t1_5_500cycle_1 = <154 4165
				154 4152
				155 4141
				156 4131
				157 4121
				159 4112
				158 4105
				160 4102
				166 4100
				170 4094
				169 4078
				169 4053
				171 4029
				170 4012
				171 4000
				171 3991
				174 3984
				175 3978
				177 3973
				178 3969
				181 3967
				183 3965
				185 3961
				185 3956
				187 3950
				188 3943
				189 3937
				191 3931
				190 3924
				192 3918
				190 3911
				189 3904
				187 3896
				184 3888
				178 3879
				174 3870
				168 3861
				164 3854
				162 3847
				160 3841
				160 3836
				159 3831
				158 3827
				159 3823
				159 3820
				159 3816
				160 3814
				161 3811
				159 3808
				161 3805
				161 3803
				164 3799
				165 3795
				164 3793
				165 3792
				166 3790
				166 3788
				166 3786
				165 3782
				165 3779
				164 3776
				163 3772
				163 3768
				163 3764
				164 3760
				164 3755
				163 3748
				163 3741
				165 3736
				167 3729
				164 3719
				164 3712
				165 3709
				168 3708
				177 3704
				186 3702
				193 3691
				184 3647
				193 3585
				210 3499>;

	r_profile_t2_500cycle_1 = <125 4174
				125 4167
				120 4151
				118 4138
				118 4127
				118 4116
				118 4106
				118 4096
				117 4086
				112 4077
				108 4071
				114 4069
				124 4065
				136 4053
				138 4034
				130 4014
				124 3998
				120 3987
				117 3978
				114 3971
				111 3966
				115 3965
				120 3961
				122 3956
				124 3949
				126 3943
				125 3935
				123 3928
				118 3920
				118 3914
				117 3907
				118 3901
				124 3897
				128 3892
				135 3881
				135 3876
				138 3870
				141 3864
				138 3855
				132 3845
				124 3835
				118 3826
				114 3819
				110 3809
				109 3805
				106 3801
				108 3797
				108 3792
				107 3789
				109 3783
				106 3781
				107 3776
				107 3773
				108 3770
				108 3769
				108 3767
				109 3766
				110 3763
				109 3760
				107 3755
				106 3748
				107 3745
				106 3736
				106 3732
				111 3726
				113 3720
				111 3713
				111 3707
				114 3701
				116 3693
				105 3683
				101 3679
				106 3677
				119 3674
				145 3669
				188 3645
				220 3596
				274 3531
				411 3438
				354 3279>;

	r_profile_t3_500cycle_1 = <94 4174
				94 4161
				95 4150
				94 4138
				94 4128
				95 4118
				95 4107
				95 4097
				96 4088
				95 4078
				97 4072
				98 4067
				97 4056
				97 4041
				97 4027
				96 4017
				98 4011
				98 4006
				98 3999
				98 3992
				99 3984
				99 3977
				100 3969
				100 3962
				101 3955
				101 3948
				102 3941
				103 3934
				103 3928
				104 3922
				104 3916
				106 3910
				106 3904
				108 3898
				111 3893
				112 3887
				113 3881
				113 3873
				109 3863
				102 3851
				99 3842
				97 3836
				96 3826
				96 3822
				96 3815
				95 3808
				97 3805
				97 3799
				98 3794
				98 3792
				99 3788
				101 3784
				102 3780
				102 3777
				101 3774
				96 3766
				96 3760
				96 3756
				96 3752
				96 3749
				96 3744
				96 3740
				96 3737
				97 3729
				97 3723
				96 3716
				95 3709
				97 3703
				97 3695
				95 3688
				97 3686
				101 3683
				105 3679
				104 3667
				101 3627
				103 3571
				110 3496
				122 3384
				122 3384
				254 3161>;
};
