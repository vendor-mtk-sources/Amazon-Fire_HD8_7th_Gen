## src/kernel/mediatek/mt8163/3.18/drivers/misc/mediatek/thermal/Kconfig
```kconfig
config MTK_THERMAL_PA_VIA_ATCMD
	bool "MTK_THERMAL_PA_VIA_ATCMD"
	help
	  Internal switch for thermal management to query modem RF
	  temperature via AT command.

config THERMAL_BISCUIT
	bool "THERMAL_BISCUIT"

config THERMAL_sbc123
	bool "Thermal support for sbc123"
	default n
	help
	  For sbc123 specific configurations for thermal related.

config THERMAL_DOUGLAS
	bool "THERMAL_DOUGLAS"

config VS_BACKLIGHT_COOLER
	bool "Virtual Sensor backlight cooler"
	default n
```
